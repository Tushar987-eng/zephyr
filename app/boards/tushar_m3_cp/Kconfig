## app/boards/tushar_m3_cp/Kconfig
```kconfig
# Copyright (c) 2016 Zephyr Contributors
# SPDX-License-Identifier: Apache-2.0

config BOARD_TUSHAR_M3_CP
	select QEMU_TARGET
```

## app/boards/tushar_m3_cp/Kconfig.tushar_m3_cp
```kconfig
# Copyright (c) 2016 Zephyr Contributors
# SPDX-License-Identifier: Apache-2.0

config BOARD_TUSHAR_M3_CP
	select SOC_TI_LM3S6965
```

## app/boards/tushar_m3_cp/board.yml
```yaml
board:
  name: tushar_m3_cp
  full_name: QEMU Emulation for ARM Cortex-M3 - Copy version
  vendor: qemu
  socs:
  - name: ti_lm3s6965
```

## app/boards/tushar_m3_scratch/board.yml
```yaml
board:
  name: tushar_m3_scratch
  full_name: QEMU Emulation for ARM Cortex-M3 - scratch version
  vendor: qemu
  socs:
  - name: ti_lm3s6965
```

## app/boards/tushar_m3_scratch/tushar_m3_scratch_defconfig
```kconfig
CONFIG_CONSOLE=y
CONFIG_UART_CONSOLE=y
CONFIG_SERIAL=y
CONFIG_QEMU_ICOUNT_SHIFT=6
```

## tests/ring_buf/testcase.yaml
```yaml
common:
  tags:
    - unit
    - ring_buf
    - ztest
    - homework

tests:
  homework.unit.ring_buf:
    platform_allow: 
     - native_sim
     - qemu_x86
     - qemu_cortex_m3
     - mps2/an385
    timeout: 60
```

## twister-out.1/qemu_cortex_m3_ti_lm3s6965/zephyr/homework.unit.ring_buf/Kconfig/boards/Kconfig.qemu_cortex_m3
```kconfig
# Load board Kconfig descriptions.
osource "/Users/tusrivastav/Documents/zephyr/deps/zephyr/boards/qemu/cortex_m3/Kconfig.qemu_cortex_m3"
```

## twister-out.1/qemu_cortex_m3_ti_lm3s6965/zephyr/homework.unit.ring_buf/Kconfig/soc/Kconfig
```kconfig
# Load Zephyr SoC Kconfig descriptions.
osource "/Users/tusrivastav/Documents/zephyr/deps/zephyr/soc/xlnx/zynqmp/Kconfig"
osource "/Users/tusrivastav/Documents/zephyr/deps/zephyr/soc/xlnx/zynq7000/Kconfig"
osource "/Users/tusrivastav/Documents/zephyr/deps/zephyr/soc/xlnx/versalnet/Kconfig"
osource "/Users/tusrivastav/Documents/zephyr/deps/zephyr/soc/xlnx/versal2/Kconfig"
osource "/Users/tusrivastav/Documents/zephyr/deps/zephyr/soc/xen/Kconfig"
osource "/Users/tusrivastav/Documents/zephyr/deps/zephyr/soc/wch/ch32v/Kconfig"
osource "/Users/tusrivastav/Documents/zephyr/deps/zephyr/soc/ti/simplelink/Kconfig"
osource "/Users/tusrivastav/Documents/zephyr/deps/zephyr/soc/ti/mspm0/Kconfig"
osource "/Users/tusrivastav/Documents/zephyr/deps/zephyr/soc/ti/lm3s6965/Kconfig"
osource "/Users/tusrivastav/Documents/zephyr/deps/zephyr/soc/ti/k3/Kconfig"
osource "/Users/tusrivastav/Documents/zephyr/deps/zephyr/soc/telink/tlsr/Kconfig"
osource "/Users/tusrivastav/Documents/zephyr/deps/zephyr/soc/starfive/jh71xx/Kconfig"
osource "/Users/tusrivastav/Documents/zephyr/deps/zephyr/soc/st/stm32/Kconfig"
osource "/Users/tusrivastav/Documents/zephyr/deps/zephyr/soc/snps/qemu_arc/Kconfig"
osource "/Users/tusrivastav/Documents/zephyr/deps/zephyr/soc/snps/nsim/arc_v/Kconfig"
osource "/Users/tusrivastav/Documents/zephyr/deps/zephyr/soc/snps/nsim/arc_classic/Kconfig"
osource "/Users/tusrivastav/Documents/zephyr/deps/zephyr/soc/snps/hsdk4xd/Kconfig"
osource "/Users/tusrivastav/Documents/zephyr/deps/zephyr/soc/snps/hsdk/Kconfig"
osource "/Users/tusrivastav/Documents/zephyr/deps/zephyr/soc/snps/emsk/Kconfig"
osource "/Users/tusrivastav/Documents/zephyr/deps/zephyr/soc/snps/emsdp/Kconfig"
osource "/Users/tusrivastav/Documents/zephyr/deps/zephyr/soc/snps/arc_iot/Kconfig"
osource "/Users/tusrivastav/Documents/zephyr/deps/zephyr/soc/silabs/Kconfig"
osource "/Users/tusrivastav/Documents/zephyr/deps/zephyr/soc/sifive/sifive_freedom/Kconfig"
osource "/Users/tusrivastav/Documents/zephyr/deps/zephyr/soc/sensry/Kconfig"
osource "/Users/tusrivastav/Documents/zephyr/deps/zephyr/soc/rockchip/Kconfig"
osource "/Users/tusrivastav/Documents/zephyr/deps/zephyr/soc/renode/riscv_virtual/Kconfig"
osource "/Users/tusrivastav/Documents/zephyr/deps/zephyr/soc/renode/cortex_r8_virtual/Kconfig"
osource "/Users/tusrivastav/Documents/zephyr/deps/zephyr/soc/renesas/smartbond/Kconfig"
osource "/Users/tusrivastav/Documents/zephyr/deps/zephyr/soc/renesas/rz/Kconfig"
osource "/Users/tusrivastav/Documents/zephyr/deps/zephyr/soc/renesas/rx/Kconfig"
osource "/Users/tusrivastav/Documents/zephyr/deps/zephyr/soc/renesas/rcar/Kconfig"
osource "/Users/tusrivastav/Documents/zephyr/deps/zephyr/soc/renesas/ra/Kconfig"
osource "/Users/tusrivastav/Documents/zephyr/deps/zephyr/soc/realtek/ec/Kconfig"
osource "/Users/tusrivastav/Documents/zephyr/deps/zephyr/soc/raspberrypi/rpi_pico/Kconfig"
osource "/Users/tusrivastav/Documents/zephyr/deps/zephyr/soc/quicklogic/eos_s3/Kconfig"
osource "/Users/tusrivastav/Documents/zephyr/deps/zephyr/soc/qemu/virt_riscv/Kconfig"
osource "/Users/tusrivastav/Documents/zephyr/deps/zephyr/soc/qemu/malta/Kconfig"
osource "/Users/tusrivastav/Documents/zephyr/deps/zephyr/soc/openisa/rv32m1/Kconfig"
osource "/Users/tusrivastav/Documents/zephyr/deps/zephyr/soc/openhwgroup/cva6/Kconfig"
osource "/Users/tusrivastav/Documents/zephyr/deps/zephyr/soc/oct/osd32mp15x/Kconfig"
osource "/Users/tusrivastav/Documents/zephyr/deps/zephyr/soc/nxp/s32/Kconfig"
osource "/Users/tusrivastav/Documents/zephyr/deps/zephyr/soc/nxp/rw/Kconfig"
osource "/Users/tusrivastav/Documents/zephyr/deps/zephyr/soc/nxp/mcx/Kconfig"
osource "/Users/tusrivastav/Documents/zephyr/deps/zephyr/soc/nxp/lpc/Kconfig"
osource "/Users/tusrivastav/Documents/zephyr/deps/zephyr/soc/nxp/layerscape/Kconfig"
osource "/Users/tusrivastav/Documents/zephyr/deps/zephyr/soc/nxp/kinetis/Kconfig"
osource "/Users/tusrivastav/Documents/zephyr/deps/zephyr/soc/nxp/imxrt/Kconfig"
osource "/Users/tusrivastav/Documents/zephyr/deps/zephyr/soc/nxp/imx/Kconfig"
osource "/Users/tusrivastav/Documents/zephyr/deps/zephyr/soc/nuvoton/numicro/Kconfig"
osource "/Users/tusrivastav/Documents/zephyr/deps/zephyr/soc/nuvoton/numaker/Kconfig"
osource "/Users/tusrivastav/Documents/zephyr/deps/zephyr/soc/nuvoton/npcx/Kconfig"
osource "/Users/tusrivastav/Documents/zephyr/deps/zephyr/soc/nuvoton/npcm/Kconfig"
osource "/Users/tusrivastav/Documents/zephyr/deps/zephyr/soc/nordic/Kconfig"
osource "/Users/tusrivastav/Documents/zephyr/deps/zephyr/soc/neorv32/Kconfig"
osource "/Users/tusrivastav/Documents/zephyr/deps/zephyr/soc/native/inf_clock/Kconfig"
osource "/Users/tusrivastav/Documents/zephyr/deps/zephyr/soc/microchip/sam/Kconfig"
osource "/Users/tusrivastav/Documents/zephyr/deps/zephyr/soc/microchip/miv/Kconfig"
osource "/Users/tusrivastav/Documents/zephyr/deps/zephyr/soc/microchip/mec/Kconfig"
osource "/Users/tusrivastav/Documents/zephyr/deps/zephyr/soc/mediatek/mt8xxx/Kconfig"
osource "/Users/tusrivastav/Documents/zephyr/deps/zephyr/soc/lowrisc/opentitan/Kconfig"
osource "/Users/tusrivastav/Documents/zephyr/deps/zephyr/soc/litex/litex_vexriscv/Kconfig"
osource "/Users/tusrivastav/Documents/zephyr/deps/zephyr/soc/ite/ec/Kconfig"
osource "/Users/tusrivastav/Documents/zephyr/deps/zephyr/soc/intel/raptor_lake/Kconfig"
osource "/Users/tusrivastav/Documents/zephyr/deps/zephyr/soc/intel/lakemont/Kconfig"
osource "/Users/tusrivastav/Documents/zephyr/deps/zephyr/soc/intel/intel_socfpga_std/Kconfig"
osource "/Users/tusrivastav/Documents/zephyr/deps/zephyr/soc/intel/intel_socfpga/Kconfig"
osource "/Users/tusrivastav/Documents/zephyr/deps/zephyr/soc/intel/intel_niosv/Kconfig"
osource "/Users/tusrivastav/Documents/zephyr/deps/zephyr/soc/intel/intel_ish/Kconfig"
osource "/Users/tusrivastav/Documents/zephyr/deps/zephyr/soc/intel/intel_adsp/Kconfig"
osource "/Users/tusrivastav/Documents/zephyr/deps/zephyr/soc/intel/elkhart_lake/Kconfig"
osource "/Users/tusrivastav/Documents/zephyr/deps/zephyr/soc/intel/atom/Kconfig"
osource "/Users/tusrivastav/Documents/zephyr/deps/zephyr/soc/intel/apollo_lake/Kconfig"
osource "/Users/tusrivastav/Documents/zephyr/deps/zephyr/soc/intel/alder_lake/Kconfig"
osource "/Users/tusrivastav/Documents/zephyr/deps/zephyr/soc/infineon/cat3/Kconfig"
osource "/Users/tusrivastav/Documents/zephyr/deps/zephyr/soc/infineon/cat1c/Kconfig"
osource "/Users/tusrivastav/Documents/zephyr/deps/zephyr/soc/infineon/cat1b/Kconfig"
osource "/Users/tusrivastav/Documents/zephyr/deps/zephyr/soc/infineon/cat1a/Kconfig"
osource "/Users/tusrivastav/Documents/zephyr/deps/zephyr/soc/gd/gd32/Kconfig"
osource "/Users/tusrivastav/Documents/zephyr/deps/zephyr/soc/gaisler/leon3/Kconfig"
osource "/Users/tusrivastav/Documents/zephyr/deps/zephyr/soc/gaisler/gr716a/Kconfig"
osource "/Users/tusrivastav/Documents/zephyr/deps/zephyr/soc/espressif/Kconfig"
osource "/Users/tusrivastav/Documents/zephyr/deps/zephyr/soc/ene/kb1200/Kconfig"
osource "/Users/tusrivastav/Documents/zephyr/deps/zephyr/soc/ene/kb106x/Kconfig"
osource "/Users/tusrivastav/Documents/zephyr/deps/zephyr/soc/efinix/sapphire/Kconfig"
osource "/Users/tusrivastav/Documents/zephyr/deps/zephyr/soc/cdns/xtensa_sample_controller/Kconfig"
osource "/Users/tusrivastav/Documents/zephyr/deps/zephyr/soc/cdns/sample_controller32/Kconfig"
osource "/Users/tusrivastav/Documents/zephyr/deps/zephyr/soc/cdns/dc233c/Kconfig"
osource "/Users/tusrivastav/Documents/zephyr/deps/zephyr/soc/brcm/bcmvk/Kconfig"
osource "/Users/tusrivastav/Documents/zephyr/deps/zephyr/soc/brcm/bcm2712/Kconfig"
osource "/Users/tusrivastav/Documents/zephyr/deps/zephyr/soc/brcm/bcm2711/Kconfig"
osource "/Users/tusrivastav/Documents/zephyr/deps/zephyr/soc/bflb/Kconfig"
osource "/Users/tusrivastav/Documents/zephyr/deps/zephyr/soc/atmel/sam0/Kconfig"
osource "/Users/tusrivastav/Documents/zephyr/deps/zephyr/soc/atmel/sam/Kconfig"
osource "/Users/tusrivastav/Documents/zephyr/deps/zephyr/soc/aspeed/Kconfig"
osource "/Users/tusrivastav/Documents/zephyr/deps/zephyr/soc/arm/Kconfig"
osource "/Users/tusrivastav/Documents/zephyr/deps/zephyr/soc/arm/beetle/Kconfig"
osource "/Users/tusrivastav/Documents/zephyr/deps/zephyr/soc/antmicro/myra/Kconfig"
osource "/Users/tusrivastav/Documents/zephyr/deps/zephyr/soc/andestech/Kconfig"
osource "/Users/tusrivastav/Documents/zephyr/deps/zephyr/soc/amd/acp_6_0/Kconfig"
osource "/Users/tusrivastav/Documents/zephyr/deps/zephyr/soc/ambiq/Kconfig"
osource "/Users/tusrivastav/Documents/zephyr/deps/zephyr/soc/aesc/Kconfig"
osource "/Users/tusrivastav/Documents/zephyr/deps/zephyr/soc/adi/max32/Kconfig"
```

## twister-out/mps2_an385/zephyr/homework.unit.ring_buf/Kconfig/arch/Kconfig
```kconfig
# Load Zephyr Arch Kconfig descriptions.
osource "/Users/tusrivastav/Documents/zephyr/deps/zephyr/arch/rx/Kconfig"
osource "/Users/tusrivastav/Documents/zephyr/deps/zephyr/arch/x86/Kconfig"
osource "/Users/tusrivastav/Documents/zephyr/deps/zephyr/arch/xtensa/Kconfig"
osource "/Users/tusrivastav/Documents/zephyr/deps/zephyr/arch/sparc/Kconfig"
osource "/Users/tusrivastav/Documents/zephyr/deps/zephyr/arch/riscv/Kconfig"
osource "/Users/tusrivastav/Documents/zephyr/deps/zephyr/arch/posix/Kconfig"
osource "/Users/tusrivastav/Documents/zephyr/deps/zephyr/arch/mips/Kconfig"
osource "/Users/tusrivastav/Documents/zephyr/deps/zephyr/arch/arm64/Kconfig"
osource "/Users/tusrivastav/Documents/zephyr/deps/zephyr/arch/arm/Kconfig"
osource "/Users/tusrivastav/Documents/zephyr/deps/zephyr/arch/arc/Kconfig"
```

## twister-out/mps2_an385/zephyr/homework.unit.ring_buf/Kconfig/boards/Kconfig
```kconfig
# Load Zephyr board Kconfig descriptions.
osource "/Users/tusrivastav/Documents/zephyr/deps/zephyr/boards/arm/mps2/Kconfig"
```

## twister-out/mps2_an385/zephyr/homework.unit.ring_buf/Kconfig/boards/Kconfig.defconfig
```kconfig
# Load Zephyr board defconfig descriptions.
osource "/Users/tusrivastav/Documents/zephyr/deps/zephyr/boards/arm/mps2/Kconfig.defconfig"
```

## twister-out/qemu_cortex_m3_ti_lm3s6965/zephyr/homework.unit.ring_buf/Kconfig/Kconfig.modules
```kconfig
menu "cmsis_6 (/Users/tusrivastav/Documents/zephyr/deps/modules/hal/cmsis_6)"
osource "$(ZEPHYR_CMSIS_6_KCONFIG)"
config ZEPHYR_CMSIS_6_MODULE
	bool
	default y
endmenu
menu "hal_nordic (/Users/tusrivastav/Documents/zephyr/deps/modules/hal/nordic)"
osource "$(ZEPHYR_HAL_NORDIC_KCONFIG)"
config ZEPHYR_HAL_NORDIC_MODULE
	bool
	default y

config ZEPHYR_HAL_NORDIC_MODULE_BLOBS
	bool
endmenu
menu "hal_nxp (/Users/tusrivastav/Documents/zephyr/deps/modules/hal/nxp)"
osource "$(ZEPHYR_HAL_NXP_KCONFIG)"
config ZEPHYR_HAL_NXP_MODULE
	bool
	default y

config ZEPHYR_HAL_NXP_MODULE_BLOBS
	bool
endmenu
config ZEPHYR_HAL_STM32_MODULE
	bool
	default y

config ZEPHYR_HAL_STM32_MODULE_BLOBS
	bool
```
